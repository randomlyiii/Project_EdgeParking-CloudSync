/**
 ******************************************************************************
 * @file    ssd1306.c
 * @brief   0.96" OLED (SSD1306, 128x64, I2C) driver for STM32MP1 M4 (HAL)
 *
 *          硬件连接（100ASK-MP157，I2C1 分配给 M4）：
 *            OLED VCC  -> 3.3V      OLED GND -> GND
 *            OLED SCL  -> PF14(I2C1_SCL)     OLED SDA -> PF15(I2C1_SDA)
 *
 *          依赖 CubeMX 生成的 hi2c1（声明在 i2c.h）。
 *          本驱动自带 1024B 显示缓存，画字后调用 ssd1306_Update() 上屏。
 ******************************************************************************
 */
#include "ssd1306.h"
#include "main.h"          /* HAL 类型 */
#include "i2c.h"           /* extern I2C_HandleTypeDef hi2c1; */

#define SSD1306_CTRL_CMD   0x00u   /* 控制字节：后续均为命令 */
#define SSD1306_CTRL_DATA  0x40u   /* 控制字节：后续均为显存数据 */

/* 显示缓存（页格式：128 列 x 8 页） */
static uint8_t ssd1306_buf[SSD1306_BUFFER_SIZE];

/* 当前光标 */
static uint8_t cur_x = 0;
static uint8_t cur_page = 0;

/*---------------------------------------------------------------------------*/
static void ssd1306_SendCmd(uint8_t cmd)
{
    uint8_t d[2];
    d[0] = SSD1306_CTRL_CMD;
    d[1] = cmd;
    HAL_I2C_Master_Transmit(&hi2c1, SSD1306_I2C_ADDR, d, 2, 100);
}

static void ssd1306_SendCmds(const uint8_t *cmds, uint16_t len)
{
    uint8_t d[SSD1306_WIDTH];
    uint16_t i, chunk;

    while (len > 0)
    {
        chunk = (len > (SSD1306_WIDTH - 1)) ? (SSD1306_WIDTH - 1) : len;
        d[0] = SSD1306_CTRL_CMD;
        for (i = 0; i < chunk; i++)
            d[i + 1] = cmds[i];
        HAL_I2C_Master_Transmit(&hi2c1, SSD1306_I2C_ADDR, d, chunk + 1, 100);
        cmds += chunk;
        len  -= chunk;
    }
}

/*---------------------------------------------------------------------------*/
void ssd1306_Init(void)
{
    /* SSD1306 标准初始化序列（128x64，内部电荷泵） */
    static const uint8_t init_cmds[] = {
        0xAE,       /* display off                     */
        0xD5, 0x80, /* 时钟分频                        */
        0xA8, 0x3F, /* 多路复用 1/64                   */
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        0x2E,       /* 关闭滚动                        */
        0xAF        /* display on                      */
    };

    ssd1306_SendCmds(init_cmds, sizeof(init_cmds));
    ssd1306_Clear(0);
    ssd1306_Update();
}

void ssd1306_Update(void)
{
    uint8_t d[SSD1306_WIDTH + 1];   /* 129B，避免占用过多栈 */
    uint8_t page;

    /* 每页先设页地址再写 128 字节显存 */
    for (page = 0; page < SSD1306_PAGES; page++)
    {
        uint8_t cmds[4];
        cmds[0] = SSD1306_CTRL_CMD;
        cmds[1] = 0xB0 + page;          /* 设置页地址 */
        cmds[2] = 0x00;                 /* 列低字节 */
        cmds[3] = 0x10;                 /* 列高字节 */
        HAL_I2C_Master_Transmit(&hi2c1, SSD1306_I2C_ADDR, cmds, 4, 100);

        d[0] = SSD1306_CTRL_DATA;
        for (uint16_t i = 0; i < SSD1306_WIDTH; i++)
            d[i + 1] = ssd1306_buf[page * SSD1306_WIDTH + i];
        HAL_I2C_Master_Transmit(&hi2c1, SSD1306_I2C_ADDR, d,
                                SSD1306_WIDTH + 1, 100);
    }
}

void ssd1306_Clear(uint8_t fill)
{
    for (uint16_t i = 0; i < SSD1306_BUFFER_SIZE; i++)
        ssd1306_buf[i] = fill ? 0xFF : 0x00;
}

void ssd1306_SetCursor(uint8_t x, uint8_t page)
{
    cur_x = (x < SSD1306_WIDTH) ? x : (SSD1306_WIDTH - 6);
    cur_page = (page < SSD1306_PAGES) ? page : (SSD1306_PAGES - 1);
}

/*---------------------------------------------------------------------------
 * 6x8 ASCII 字模：每字符 6 字节 = 5 列点阵 + 1 列间隔。
 * 索引 = ASCII码 - 0x20；ssd1306_WriteString() 把小写折叠为大写取用，
 * 保证显示可靠。若某字符显示花，按"ASCII码-32"找到对应行替换即可。
 *-------------------------------------------------------------------------*/
static const uint8_t font6x8[95][6] = {
    {0x00,0x00,0x00,0x00,0x00,0x00}, /* 32 ' ' */
    {0x00,0x00,0x5F,0x00,0x00,0x00}, /* 33 '!' */
    {0x00,0x07,0x00,0x07,0x00,0x00}, /* 34 '"' */
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    {0x10,0x08,0x08,0x10,0x08,0x00}, /* 126 '~' */
};

/*---------------------------------------------------------------------------*/
void ssd1306_WriteString(const char *str)
{
    while (str && *str)
    {
        uint8_t ch = (uint8_t)(*str++);

        if (ch >= 'a' && ch <= 'z')   /* 小写折叠为大写，取用已验证字模 */
            ch -= ('a' - 'A');

        if (ch >= 0x20 && ch <= 0x7E)
        {
            const uint8_t *g = font6x8[ch - 0x20];

            if (cur_x + 6 <= SSD1306_WIDTH)
            {
                for (uint8_t c = 0; c < 6; c++)   /* 5 列点阵 + 1 列间隔 */
                    ssd1306_buf[cur_page * SSD1306_WIDTH + cur_x + c] = g[c];
                cur_x += 6;
            }
        }
        /* 换行：\n 跳到下一页开头 */
        else if (ch == '\n')
        {
            cur_x = 0;
            if (cur_page < SSD1306_PAGES - 1)
                cur_page++;
        }
    }
}
